## esp32/components/geogram_common/Kconfig.projbuild
```kconfig
menu "Geogram Board Selection"

    choice GEOGRAM_BOARD
        prompt "Geogram board model"
        default GEOGRAM_BOARD_EPAPER_1IN54

        config GEOGRAM_BOARD_EPAPER_1IN54
            bool "ESP32-S3 ePaper 1.54 (Waveshare)"
            depends on IDF_TARGET_ESP32S3

        config GEOGRAM_BOARD_TDONGLE_S3
            bool "LILYGO T-Dongle-S3 LCD"
            depends on IDF_TARGET_ESP32S3

        config GEOGRAM_BOARD_HELTEC_V3
            bool "Heltec WiFi LoRa 32 V3"
            depends on IDF_TARGET_ESP32S3

        config GEOGRAM_BOARD_ESP32C3_MINI
            bool "ESP32-C3 Mini"
            depends on IDF_TARGET_ESP32C3

        config GEOGRAM_BOARD_HELTEC_V2
            bool "Heltec WiFi LoRa 32 V2"
            depends on IDF_TARGET_ESP32

        config GEOGRAM_BOARD_HELTEC_V1
            bool "Heltec WiFi LoRa 32 V1"
            depends on IDF_TARGET_ESP32

        config GEOGRAM_BOARD_KV4P
            bool "KV4P-HT (SA818)"
            depends on IDF_TARGET_ESP32

        config GEOGRAM_BOARD_GENERIC
            bool "Generic ESP32"
            depends on IDF_TARGET_ESP32

    endchoice

endmenu
```

## esp32/sdkconfig.defaults
```kconfig
# Common ESP-IDF configuration for all Geogram boards
# Board-specific overrides are in boards/sdkconfig.<env>

# Compiler options
CONFIG_COMPILER_OPTIMIZATION_SIZE=y

# FreeRTOS
CONFIG_FREERTOS_HZ=1000
CONFIG_FREERTOS_USE_TRACE_FACILITY=y

# Log level
CONFIG_LOG_DEFAULT_LEVEL_INFO=y
CONFIG_LOG_DEFAULT_LEVEL=3

# Partition table
CONFIG_PARTITION_TABLE_CUSTOM=y
CONFIG_PARTITION_TABLE_CUSTOM_FILENAME="partitions.csv"

# HTTP Server
CONFIG_HTTPD_MAX_REQ_HDR_LEN=1024
CONFIG_HTTPD_MAX_URI_LEN=512
CONFIG_HTTPD_WS_SUPPORT=y

# LWIP socket limits (increased for mesh + multiple HTTP clients)
CONFIG_LWIP_MAX_SOCKETS=16
CONFIG_LWIP_MAX_ACTIVE_TCP=16
CONFIG_LWIP_MAX_LISTENING_TCP=8
CONFIG_LWIP_NETIF_API=y

# SSH server authentication
CONFIG_EXAMPLE_ALLOW_PASSWORD_AUTH=y
CONFIG_EXAMPLE_ALLOW_PUBLICKEY_AUTH=n

# mbedTLS threading (required for SSH server libssh)
CONFIG_MBEDTLS_THREADING_C=y
CONFIG_MBEDTLS_THREADING_ALT=n
CONFIG_MBEDTLS_THREADING_PTHREAD=y

# Allow insecure TLS connections (needed for tile downloads without cert verification)
CONFIG_ESP_TLS_INSECURE=y
CONFIG_ESP_TLS_SKIP_SERVER_CERT_VERIFY=y
```
